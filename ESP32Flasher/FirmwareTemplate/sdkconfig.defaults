## ESP32Flasher/FirmwareTemplate/sdkconfig.defaults
```kconfig
# Canon C200 Camera Controller - ESP32-S3 Configuration

# Power Management - Enable for better battery life
CONFIG_PM_ENABLE=y
CONFIG_PM_DFS_INIT_AUTO=y

# WiFi Power Save - Light sleep for better power efficiency
CONFIG_ESP_WIFI_STA_DISCONNECTED_PM_ENABLE=y

# CPU Frequency (ESP32-S3 can run at 240MHz)
CONFIG_ESP_DEFAULT_CPU_FREQ_MHZ_160=y

# ESP32-S3 Specific Settings
CONFIG_IDF_TARGET="esp32s3"
CONFIG_IDF_TARGET_ESP32S3=y

# Flash and PSRAM Configuration (for ESP32-S3-ETH boards)
CONFIG_ESPTOOLPY_FLASHSIZE_16MB=y
CONFIG_SPIRAM=y
CONFIG_SPIRAM_MODE_OCT=y
CONFIG_SPIRAM_SPEED_80M=y

# USB Serial (ESP32-S3 has USB built-in)
CONFIG_ESP_CONSOLE_USB_SERIAL_JTAG=y

# Ethernet
CONFIG_ETH_ENABLED=y
CONFIG_ETH_USE_SPI_ETHERNET=y
CONFIG_ETH_SPI_ETHERNET_W5500=y

# Network stack optimization
CONFIG_LWIP_MAX_SOCKETS=16
CONFIG_LWIP_SO_REUSE=y
CONFIG_LWIP_SO_REUSE_RXTOALL=y

# TCP/IP settings for better performance
CONFIG_LWIP_TCP_SND_BUF_DEFAULT=8192
CONFIG_LWIP_TCP_WND_DEFAULT=8192
CONFIG_LWIP_TCP_RECVMBOX_SIZE=16
CONFIG_LWIP_UDP_RECVMBOX_SIZE=16

# HTTP Client (for camera API)
CONFIG_ESP_HTTP_CLIENT_ENABLE_HTTPS=n
CONFIG_ESP_HTTP_CLIENT_ENABLE_BASIC_AUTH=y

# HTTP Server (for control API)
CONFIG_HTTPD_MAX_REQ_HDR_LEN=1024
CONFIG_HTTPD_MAX_URI_LEN=512
CONFIG_HTTPD_WS_SUPPORT=y

# mDNS (for Bonjour discovery)
CONFIG_MDNS_MAX_SERVICES=10

# Compiler optimization for size (better for power)
CONFIG_COMPILER_OPTIMIZATION_SIZE=y

# Enable task watchdog
CONFIG_ESP_TASK_WDT=y
CONFIG_ESP_TASK_WDT_TIMEOUT_S=10

# Console settings
CONFIG_ESP_CONSOLE_UART_DEFAULT=y
CONFIG_ESP_CONSOLE_UART_BAUDRATE=115200

# Partition table (OTA dual-app layout)
CONFIG_PARTITION_TABLE_CUSTOM=y
CONFIG_PARTITION_TABLE_CUSTOM_FILENAME="partitions.csv"
CONFIG_BOOTLOADER_APP_ROLLBACK_ENABLE=y

# FreeRTOS
CONFIG_FREERTOS_HZ=1000
CONFIG_FREERTOS_USE_TICKLESS_IDLE=y

# Event loop - increased stack for HTTP client callbacks
CONFIG_ESP_SYSTEM_EVENT_TASK_STACK_SIZE=6144
```
